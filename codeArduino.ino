/*
  AIRCARTO Version6 sur BLUE PILL (STM32)

  Type de Carte: Generic STM32F103C series
  Upload Metho: Serial
  Port: SLAB_USBtoUART
  
  SDS011 (5V):
  TX -> PA3
  
  Ecran 1.8'' 128x160 rgb_tft (5V):
  SCL -> SCK(pin PA5)
  SDA -> MOSI(pin PA7)
  CS  -> PB9
  RST -> PA8
  DC  -> PB8

  Module SD:
  MOSI -> MOSI(pin PA7)
  MISO -> MISO(pin PA6)
  CLK  -> SCK(pin PA5)
  CS  -> PA4

   Paul Vuarambon
   24 novembre 2020
 
 */

//recopier ici l'identifiant du capteur
char id_capteur[] = "aircarto_v6_2021_001";

//choisir ici la fréquence des mesures en ms
int frequence_mesure_ms = 2000;



//sensor de particules fines SDS011
#include <SDS011-select-serial.h>
float p10,p25;
int error;
SDS011 my_sds(Serial2);

//Ecran 1.8'
#include <Adafruit_GFX.h>    // Core graphics library
#include <Adafruit_ST7735.h> // Hardware-specific library for ST7735
#include <SPI.h>

#define TFT_CS        PB9
#define TFT_RST       PA8
#define TFT_DC        PB8
  
Adafruit_ST7735 tft = Adafruit_ST7735(TFT_CS, TFT_DC, TFT_RST);

//module SD
#include <SD.h>
File myFile;

//pour le GPS on utilise la Librairie TinyGPS++
#include <TinyGPS++.h>
TinyGPSPlus tinyGPS;
HardwareSerial & ss = Serial3;

#include <math.h>

//variable pour dessiner les lignes
int placeX = 41;

//LOGOS **********************

const unsigned char logoAircarto [] PROGMEM = {
0x00, 0x00, 0x00, 0x00, 0x00, 0x00, 0x00, 0x00, 0x00, 0x00, 0x00, 0x00,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 0x00, 
  0x00, 0x00, 0x00, 0x00, 0x00, 0x00, 0x00, 0x00, 0x00, 0x00, 0x00, 0x00, 0x00, 0x00, 0x00, 0x00, 0x00, 0x00, 0x00, 0x00, 0x00, 0x01, 0xff, 0xf0, 0x00, 0x00, 0x00, 0x00, 0x00, 0x00, 0x00, 0x00, 
  0x00, 0x00, 0x00, 0x00, 0x00, 0x0f, 0xff, 0xff, 0x00, 0x00, 0x00, 0x00, 0x00, 0x00, 0x00, 0x00, 0x00, 0x00, 0x00, 0x00, 0x00, 0x7f, 0xff, 0xff, 0xc0, 0x00, 0x00, 0x00, 0x00, 0x00, 0x00, 0x00, 
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  0x00, 0x00, 0x00, 0x00, 0x00, 0x00, 0x00, 0x00, 0x00, 0x00, 0x00, 0x00,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 0x00

};

const unsigned char logoSignal_low [] PROGMEM = {
  // 'signal_low, 18x18px
  0x00, 0x00, 0x00, 0x00, 0x00, 0x00, 0x00, 0x00, 0x00, 0x00, 0x00, 0x00,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 0x80, 
  0x79, 0xe7, 0x80, 0x00, 0x00, 0x00
};

const unsigned char logoSignal_mid [] PROGMEM = {
  // 'signal_mid, 18x18px
  0x00, 0x00, 0x00, 0x00, 0x00, 0x00, 0x00, 0x00, 0x00, 0x00, 0x00, 0x00,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 0x80, 
  0x79, 0xe7, 0x80, 0x00, 0x00, 0x00
};

const unsigned char logoSignal_full [] PROGMEM = {
  // 'signal_full, 18x18px
  0x00, 0x00, 0x00, 0x00, 0x07, 0x80, 0x00, 0x07, 0x80, 0x00, 0x07, 0x80,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 0x80, 
  0x79, 0xe7, 0x80, 0x00, 0x00, 0x00
};


void setup() {
  Serial.begin(9600);
  Serial2.begin(9600);          //SDS011
  ss.begin(9600);              //départ GPS
  tft.initR(INITR_BLACKTAB);   //écran
  SD.begin(PA4);               // module SD

   
  
  //logo AIRCARTO ******************************************
  tft.fillScreen(ST77XX_BLACK);
  tft.setCursor(115,0);
  tft.setTextWrap(false);
  tft.setTextColor(ST77XX_WHITE);
  tft.setTextSize(1);
  tft.println("V6");
  tft.drawBitmap(0, 0, logoAircarto, 128, 127, ST77XX_BLUE);
  delay(500);
  tft.setCursor(0,125);
  tft.setTextWrap(false);
  tft.setTextColor(ST77XX_WHITE);
  tft.setTextSize(1);
  tft.println("   Capteur mobile de ");
  tft.println("       pollution     ");
  tft.println("     atmospherique    ");
  delay(5000);

  //vérification SD
  
   tft.fillScreen(ST77XX_BLACK);
   tft.setTextWrap(false);
   tft.setTextColor(ST77XX_WHITE);
   tft.setTextSize(1);
   tft.setCursor(0,0);
   tft.println("ID capteur:");
   tft.println(id_capteur);
   delay(1000);
   tft.println("...");
   tft.println("Test carte SD:");
   delay(500);
   tft.println("...");
   delay(500);
   tft.println("...");

   

  
  delay(500);
  
  if (SD.exists("DATA.txt")) {
    tft.println("fichier DATA.txt");
    delay(500);
    tft.println("...");
    tft.println("OK");

  } else {
    tft.println("Fichier non trouve");
    delay(500);
    tft.println("Verifier carte SD");
    delay(500);
  }

  
  delay(2000);
  tft.fillScreen(ST77XX_BLACK);
  
  myFile = SD.open("DATA.txt", FILE_WRITE); //ATTENTION ne pas utiliser de majuscule dans le nom du fichier
  myFile.println("PM2.5, PM10,Latitude, Longitude, Date, Heure, ID_capteur");
  myFile.close();

}



void loop() {
  myFile = SD.open("DATA.txt", FILE_WRITE);

  //carré noir en haut
  tft.fillRect(0,0,128,20,ST77XX_BLACK);

  //carrés noir pour les mesures PM2.5 et PM10
  tft.fillRect(0,40,50,16,ST77XX_BLACK);
  tft.fillRect(0,98,50,16,ST77XX_BLACK);


  // ******* INFO TOP : SIGNAL GPS et BATTERIE*******************************

  tft.setTextColor(ST77XX_WHITE);
  tft.setTextSize(1);
  tft.setCursor(4, 10);
  tft.print("GPS" );


  if (tinyGPS.satellites.value()==0){
      tft.drawBitmap(25, 0, logoSignal_low, 18, 18, ST77XX_WHITE);
  }
  else if (tinyGPS.satellites.value()<=3){
      tft.drawBitmap(25, 0, logoSignal_mid, 18, 18, ST77XX_WHITE);
  }
  else {
         tft.drawBitmap(25, 0, logoSignal_full, 18, 18, ST77XX_WHITE);
  }
  
  tft.setTextColor(ST77XX_WHITE);
  tft.setTextSize(1);
  tft.setCursor(80, 10);
  
  tft.print(tinyGPS.time.hour());
  tft.print(":" );
  tft.print(tinyGPS.time.minute());
  tft.print(":" );
  tft.print(tinyGPS.time.second());
  tft.print("  " );


  //PARTICULES FINES
  error = my_sds.read(&p25,&p10);
  if (! error) {
    
    //INFOS ECRAN PM2.5 *************
    tft.setTextColor(ST77XX_RED);
    tft.setTextSize(1);
    tft.setCursor(0,33);

    tft.println("PM2.5:");
    tft.setTextSize(2);
    tft.println(p25,0);
    tft.setTextSize(1);
    tft.println("ugm/3");

    //graphique 
     if (p25<88){
      tft.drawLine(placeX,74, placeX,74-(p25/2), ST77XX_RED);
     }
     else {
     tft.drawLine(placeX,74, placeX,20, ST77XX_RED);   
     }
     
     //INFOS ECRAN PM10 *************
     tft.setTextColor(ST77XX_GREEN);
     tft.setCursor(0,90);

     tft.println("PM10: ");
     tft.setTextSize(2);
     tft.println(p10,0);
     tft.setTextSize(1);
     tft.println("ugm/3");

      //graphique
      if (p10<100){
      tft.drawLine(placeX,130, placeX,130-(p10/2), ST77XX_GREEN);
      }
      else{
         tft.drawLine(placeX,130, placeX,80, ST77XX_GREEN);
      }
      //lignes noir pour remplacement/actualisation des nouvelles lignes
      tft.drawLine(placeX+1,156, placeX+1,21, ST77XX_BLACK);    
      tft.drawLine(placeX+2,156, placeX+2,21, ST77XX_BLACK);
      tft.drawLine(placeX+3,156, placeX+3,21, ST77XX_BLACK);
      tft.drawLine(placeX+4,156, placeX+4,21, ST77XX_BLACK);

    //Impression SD
    myFile.print(String(p25));
    myFile.print(",");
    myFile.print(String(p10));
    myFile.print(",");
    
  }


  // BOTTOM TEXT
  tft.setTextColor(ST77XX_BLUE);
  tft.setTextSize(2);
  tft.setCursor(0, 145);
  tft.println("AirCarto.fr");


  // infos GPS sur carte SD
  

  myFile.print(tinyGPS.location.lat(),6);
  myFile.print(",");
  myFile.print(tinyGPS.location.lng(),6);
  myFile.print(",");

  myFile.print(tinyGPS.date.year());
  myFile.print("-");
  myFile.print(tinyGPS.date.month());
  myFile.print("-");
  myFile.print(tinyGPS.date.day());
  myFile.print(",");

  myFile.print(tinyGPS.time.hour());
  myFile.print(":");
  myFile.print(tinyGPS.time.minute());
  myFile.print(":");
  myFile.print(tinyGPS.time.second());
    
  //ID_capteur
  myFile.print(",");
  myFile.println(id_capteur);



  //fermeture fichier SD
    myFile.close();
    
  //fréquene des mesures
  smartDelay(frequence_mesure_ms);

  //on déplacement des lignes de l'histogramme
  placeX = placeX + 1;
  if (placeX >= 128){
    placeX=41;
  }

}



static void smartDelay(unsigned long ms)
{
  unsigned long start = millis();
  do
  {
    while (ss.available())
      tinyGPS.encode(ss.read());
  } while (millis() - start < ms);
}
